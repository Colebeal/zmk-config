## boards/boardsource/blecorne/board.yml
```yaml
boards:
  - name: blecorne_left
    vendor: boardsource
    socs:
      - name: nrf52840
    revision:
      format: major.minor.patch
      default: 1.0.0
      exact: false
      revisions:
        - name: 1.0.0
  - name: blecorne_right
    vendor: boardsource
    socs:
      - name: nrf52840
    revision:
      format: major.minor.patch
      default: 1.0.0
      exact: false
      revisions:
        - name: 1.0.0
```
